## target/linux/avr32/image/Config.in
```kconfig
config AVR32_UBOOT
	bool "Build U-Boot bootloader"
	depends TARGET_avr32
	default n

config AVR32_UBOOT_TARGET
	string "U-Boot target board"
	depends TARGET_avr32
	depends AVR32_UBOOT
	default "atngw100"
	help
	  For all supported boards there are ready-to-use default
		configurations available; just type "<board_name>".

config AVR32_COPY_UIMAGE
	bool "Copy uImage into target filesystem"
	depends TARGET_avr32
	default n
	help
	  Copy kernel image into /boot in target filesystem
```
